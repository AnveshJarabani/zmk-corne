## boards/Kconfig
```kconfig
# SPDX-License-Identifier: MIT
# Copyright (c) 2024 The ZMK Contributors

# Source board-specific Kconfig files
osource "$(BOARD_DIR)/Kconfig.$(BOARD)"
```

## boards/eyelash/eyelash_corne/Kconfig.defconfig
```kconfig
#
# Copyright (c) 2024 The ZMK Contributors
# SPDX-License-Identifier: MIT
#

if BOARD_EYELASH_CORNE_LEFT || BOARD_EYELASH_CORNE_RIGHT

if USB_DEVICE_STACK

config USB_NRFX
    default y

endif # USB_DEVICE_STACK

config BT_CTLR
    default BT

endif # BOARD_EYELASH_CORNE_LEFT || BOARD_EYELASH_CORNE_RIGHT
```

## boards/eyelash/eyelash_corne/board.yml
```yaml
boards:
  - name: eyelash_corne_left
    vendor: eyelash
    socs:
      - name: nrf52840
        variant: qiaa
    revision:
      format: major.minor.patch
      default: 1.0.0
      exact: false
      revisions:
        - name: 1.0.0
          qualifiers:
            - nrf52840
  - name: eyelash_corne_right
    vendor: eyelash
    socs:
      - name: nrf52840
        variant: qiaa
    revision:
      format: major.minor.patch
      default: 1.0.0
      exact: false
      revisions:
        - name: 1.0.0
          qualifiers:
            - nrf52840
```
